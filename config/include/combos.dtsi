/*
╭─────────────────────┬─────────────────────╮
│ LT4 LT3 LT2 LT1 LT0 │ RT0 RT1 RT2 RT3 RT4 │
│ LM4 LM3 LM2 LM1 LM0 │ RM0 RM1 RM2 RM3 RM4 │
│ LB4 LB3 LB2 LB1 LB0 │ RB0 RB1 RB2 RB3 RB4 │
╰───────╮ LH2 LH1 LH0 │ RH0 RH1 RH2 ╭───────╯
        ╰─────────────┴─────────────╯       */

#define COMBO(NAME, BINDINGS, KEYPOS, LAYERS, TERM, QUICKTAP, ...) \
    combo_##NAME { \
        timeout-ms = <TERM>; \
        bindings = <BINDINGS>; \
        key-positions = <KEYPOS>; \
        layers = <LAYERS>; \
        require-prior-idle-ms = <QUICKTAP>; \
        __VA_ARGS__ \
    };

/ {
    macros {
        qu: qu {
            compatible = "zmk,behavior-macro";
            #binding-cells = <0>;
            bindings = <&macro_tap &kp Q &kp U>;
        };
    };

    behaviors {
        bd: bspc_del {
            compatible = "zmk,behavior-mod-morph";
            #binding-cells = <0>;
            bindings = <&kp BSPC>, <&kp DEL>;
            mods = <(MOD_LSFT|MOD_RSFT)>;
        };

        tg: tilde_grave {
            compatible = "zmk,behavior-mod-morph";
            #binding-cells = <0>;
            bindings = <&kp TILDE>, <&kp GRAVE>;
            mods = <(MOD_LSFT|MOD_RSFT)>;
        };
    };

    combos {
        compatible = "zmk,combos";

        COMBO(cw,	&caps_word,	LM1 RM1,	BASE NUMS NAVI,	75,	0)
        COMBO(cl,	&kp CAPS,	LM2 RM2,	BASE NUMS NAVI,	75,	0)

        COMBO(esc,	&kp ESC,	LM3 LM2 LM1,	BASE NUMS NAVI,	50,	0) // left hand homerow combos
        COMBO(lshft,	&sk LSHFT,	LM3 LM2,	BASE NUMS NAVI,	50,	100)
        COMBO(tab,	&kp TAB,	LM2 LM1,	BASE NUMS NAVI,	50,	100)
        COMBO(equal,	&kp EQUAL,	LM3 LM1,	BASE NUMS NAVI,	50,	100)

        COMBO(ret,	&kp RET,	RM1 RM2 RM3,	BASE NUMS NAVI,	50,	0) // right hand homerow combos
        COMBO(rshft,	&sk RSHFT,	RM2 RM3,	BASE NUMS NAVI,	50,	100)
        COMBO(bd,	&bd,		RM1 RM2,	BASE NUMS NAVI,	50,	100)
        COMBO(semi,	&kp SEMI,	RM1 RM3,	BASE NUMS NAVI,	50,	100)

        COMBO(lbkt,	&kp LBKT,	LT3 LM3,	BASE NUMS NAVI,	50,	0) // left hand vertical combos
        COMBO(lbrc,	&kp LBRC,	LT2 LM2,	BASE NUMS NAVI,	50,	0)
        COMBO(lpar,	&kp LPAR,	LT1 LM1,	BASE NUMS NAVI,	50,	0)
        COMBO(lt,	&kp LT,		LT0 LM0,	BASE NUMS NAVI,	50,	0)
        COMBO(tg,	&tg,		LM3 LB3,	BASE NUMS NAVI,	50,	0)
        COMBO(plus,	&kp PLUS,	LM2 LB2,	BASE NUMS NAVI,	50,	0)
        COMBO(star,	&kp STAR,	LM1 LB1,	BASE NUMS NAVI,	50,	0)

        COMBO(rbkt,	&kp RBKT,	RT3 RM3,	BASE NUMS NAVI,	50,	0) // right hand vertical combos
        COMBO(rbrc,	&kp RBRC,	RT2 RM2,	BASE NUMS NAVI,	50,	0)
        COMBO(rpar,	&kp RPAR,	RT1 RM1,	BASE NUMS NAVI,	50,	0)
        COMBO(gt,	&kp GT,		RT0 RM0,	BASE NUMS NAVI,	50,	0)
        COMBO(bslh,	&kp BSLH,	RM3 RB3,	BASE NUMS NAVI,	50,	0)
        COMBO(minus,	&kp MINUS,	RM2 RB2,	BASE NUMS NAVI,	50,	0)
        COMBO(fslh,	&kp FSLH,	RM1 RB1,	BASE NUMS NAVI,	50,	0)
    };
};
